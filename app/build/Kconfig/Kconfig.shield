## app/build/Kconfig/Kconfig.shield
```kconfig
osource "/home/kongchen/Project/STM32_F401_Basic_Framework/boards/shields/*/Kconfig.shield"
```

## app/build/Kconfig/arch/Kconfig
```kconfig
# Load Zephyr Arch Kconfig descriptions.
osource "/home/kongchen/Project/Zephyr/zephyr/arch/rx/Kconfig"
osource "/home/kongchen/Project/Zephyr/zephyr/arch/x86/Kconfig"
osource "/home/kongchen/Project/Zephyr/zephyr/arch/xtensa/Kconfig"
osource "/home/kongchen/Project/Zephyr/zephyr/arch/sparc/Kconfig"
osource "/home/kongchen/Project/Zephyr/zephyr/arch/riscv/Kconfig"
osource "/home/kongchen/Project/Zephyr/zephyr/arch/posix/Kconfig"
osource "/home/kongchen/Project/Zephyr/zephyr/arch/openrisc/Kconfig"
osource "/home/kongchen/Project/Zephyr/zephyr/arch/mips/Kconfig"
osource "/home/kongchen/Project/Zephyr/zephyr/arch/arm64/Kconfig"
osource "/home/kongchen/Project/Zephyr/zephyr/arch/arm/Kconfig"
osource "/home/kongchen/Project/Zephyr/zephyr/arch/arc/Kconfig"
```

## app/build/Kconfig/boards/Kconfig
```kconfig
# Load Zephyr board Kconfig descriptions.
osource "/home/kongchen/Project/STM32_F401_Basic_Framework/boards/others/stm32_f401_dev/Kconfig"
```

## app/build/Kconfig/boards/Kconfig.defconfig
```kconfig
# Load Zephyr board defconfig descriptions.
osource "/home/kongchen/Project/STM32_F401_Basic_Framework/boards/others/stm32_f401_dev/Kconfig.defconfig"
```

## boards/others/stm32_f401_dev/board.yml
```yaml
board:
  name: stm32_f401_dev
  full_name: stm32_f401_development_board
  vendor: others
  socs:
    - name: stm32f401xe
```

## boards/others/stm32_f401_dev/stm32_f401_dev_defconfig
```kconfig
CONFIG_SERIAL=y
CONFIG_CONSOLE=y
CONFIG_UART_CONSOLE=y
CONFIG_GPIO=y
# Enable MPU
CONFIG_ARM_MPU=y
# OLED (SSD1312)
CONFIG_I2C=y
CONFIG_DISPLAY=y
CONFIG_CHARACTER_FRAMEBUFFER=y
CONFIG_HEAP_MEM_POOL_SIZE=4096
# 主线程栈默认1024不够,曾致栈溢出崩溃
CONFIG_MAIN_STACK_SIZE=4096
# 栈溢出提前检测与线程名(崩溃日志可读)
CONFIG_STACK_SENTINEL=y
CONFIG_THREAD_NAME=y
```

## modules/bmp280/drivers/bmp280/Kconfig
```kconfig
# Create a new option in menuconfig
config BOSCH_BMP280
    bool "Bosch bmp280"
    default n       # Set the driver to be disabled by default
    depends on I2C  # Make it dependent on i2c driver
    help
        Enable the Bosch bmp280 driver.
```

## modules/bmp280/dts/bindings/baro/bosch,bmp280.yaml
```yaml
description: |
  Bosch BMP280 digital barometric pressure and temperature sensor, driven by I2C
compatible: "bosch,bmp280"

include: i2c-device.yaml
```

## modules/kt6368a/dts/bindings/bt/qinyue,kt6368a.yaml
```yaml
description: |
  Qinyue KT6368A dual-mode (BLE + SPP) bluetooth chip, driven by UART.
  Default serial settings are 115200 baud, 8N1, no flow control - they
  must match the chip or the AT commands get no reply.
compatible: "qinyue,kt6368a"

include: uart-device.yaml

properties:
  sta-gpios:
    type: phandle-array
    required: false
    description: |
      GPIO connected to the module STA status pin: high = a bluetooth
      peer is connected, low = not connected. Vendor docs mention some
      module batches pulse ~10Hz on this pin while unconnected, but
      measured units just hold it low.
```

## modules/mpu6050/drivers/mpu6050/Kconfig
```kconfig
# Create a new option in menuconfig
config TDK_MPU6050
    bool "Tdk mpu6050"
    default n       # Set the driver to be disabled by default
    depends on I2C  # Make it dependent on i2c driver
    help 
        Enable the Tdk mpu6050 driver.
```

## modules/mpu6050/dts/bindings/gyro/tdk,mpu6050.yaml
```yaml
description: |
  TDK MPU6050, driven by I2C
compatible: "tdk,mpu6050"

include: i2c-device.yaml

properties:
  size:
    type: int
    description: |
      mpu6050
```

## modules/qmc5883l/drivers/qmc5883l/Kconfig
```kconfig
# Create a new option in menuconfig
config QST_QMC5883L
    bool "Qst qmc5883l"
    default n       # Set the driver to be disabled by default
    depends on I2C  # Make it dependent on i2c driver
    help 
        Enable the Qst qmc5883l driver.
```

## modules/qmc5883l/dts/bindings/mag/qst,qmc5883l.yaml
```yaml
description: |
  QST QMC5883L 3-axis magnetometer, driven by I2C
compatible: "qst,qmc5883l"

include: i2c-device.yaml
```

## modules/sht30/drivers/sht30/Kconfig
```kconfig
# Create a new option in menuconfig
config SENSIRION_SHT30
    bool "Sensirion sht30"
    default n       # Set the driver to be disabled by default
    depends on I2C  # Make it dependent on i2c driver
    help
        Enable the Sensirion sht30 driver.
```

## modules/sht30/dts/bindings/trh/sensirion,sht30.yaml
```yaml
description: |
  Sensirion SHT30 digital temperature and humidity sensor, driven by I2C
compatible: "sensirion,sht30"

include: i2c-device.yaml
```

## modules/w25q128/drivers/w25q128/Kconfig
```kconfig
# Create a new option in menuconfig
config WINBOND_W25Q128
    bool "Winbond w25q128"
    default n       # Set the driver to be disabled by default
    depends on SPI  # Make it dependent on SPI driver
    help 
        Enable the Winbond w25q128 driver.
```

## modules/w25q128/dts/bindings/flash/winbond,w25q128.yaml
```yaml
description: |
  Winbond W25Q128 SPI NOR Flash (128Mbit), driven by SPI
compatible: "winbond,w25q128"

include: spi-device.yaml

properties:
  size:
    type: int
    description: |
      Flash capacity in bits. 128 Mbit = 0x8000000.
```
