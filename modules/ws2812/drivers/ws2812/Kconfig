## modules/ws2812/drivers/ws2812/Kconfig
```kconfig
# Create a new option in menuconfig
config CUSTOM_WS2812
    bool "Custom ws2812"
    default n       # Set the driver to be disabled by default
    depends on PWM # Make it dependent on PWM driver
    depends on DMA # Make it dependent on DMA driver
    help 
        Enable the custom ws2812 driver.
```

## modules/ws2812/dts/bindings/led_strip/custom,ws2812.yaml
```yaml
# SPDX-License-Identifier: Apache-2.0

description: |
  Custom WS2812 LED strip driven by PWM + DMA.

compatible: "custom,ws2812"

include: led-strip.yaml

properties:
  pwms:
    type: phandle-array
    required: true

  dmas:
    type: phandle-array
    required: true

  dma-names:
    type: string-array
    required: true

  reset-delay:
    type: int
    default: 80
```

## modules/ws2812/dts/bindings/led_strip/worldsemi_ws2812_pwm.yaml
```yaml
# SPDX-License-Identifier: Apache-2.0

description: |
  WS2812 LED strip driven by PWM + DMA (Worldsemi WS2812 PWM driver).

compatible: "worldsemi_ws2812_pwm"

include: led-strip.yaml

properties:
  pwms:
    type: phandle-array
    required: true

  dmas:
    type: phandle-array
    required: true

  dma-names:
    type: string-array
    required: true

  zero-pulse-ns:
    type: int
    required: true
    description: |
      Zero-bit high pulse width in nanoseconds.

  one-pulse-ns:
    type: int
    required: true
    description: |
      One-bit high pulse width in nanoseconds.

  reset-delay:
    type: int
    default: 80
    description: |
      Reset low time in microseconds.
```
